// E.D.A dengebot v1.7.6 STEP/DIR FIX3 - motor hardware test using library adapter.
// ESP32-WROOM + two STEP/DIR drivers; NO PID and NO IMU.
// PLEASE keep wheels OFF ground, verify supply/current and driver levels.
// PWM-style STEP pulses are generated by independent ESP32 LEDC hardware.
#include <Arduino.h>
#if defined(ARDUINO_ARCH_ESP32) && defined(CONFIG_IDF_TARGET_ESP32)
#include <EDAStepDirLEDC_ESP32.h>

static constexpr uint8_t L_STEP=18, L_DIR=19, R_STEP=23, R_DIR=5, EN=33;
static constexpr bool L_FORWARD_HIGH=true, R_FORWARD_HIGH=false;
// FIX3: low rates 200/500/1000 added for diagnosing "buzzes, no rotation".
static constexpr uint32_t RATES[]={200,500,1000,2000,5000,10000,20000,40000};
static constexpr uint8_t RATE_COUNT=sizeof(RATES)/sizeof(RATES[0]);
static constexpr uint32_t TEST_MS=2000;       // hold time AFTER the ramp reaches the target
static constexpr uint32_t MAX_TEST_MS=6000;   // hard cap including the ramp
static constexpr uint32_t START_SPS=200;      // ramp start (below pull-in limit)
static constexpr uint32_t RAMP_INTERVAL_MS=10;
static constexpr uint32_t RAMP_INCREMENT_SPS=200; // = 20000 STEP/s^2
static EDA::StepDirLEDC_ESP32 motor(L_STEP,L_DIR,R_STEP,R_DIR,EN,
                                    L_FORWARD_HIGH,R_FORWARD_HIGH);
static bool active=false;
static uint32_t startMs=0,lastUpdateMs=0,holdStartMs=0;
static bool holding=false;
static uint32_t currentSps=0;
static uint8_t rateIndex=3,selection=5; // default 2000 STEP/s

static int32_t signedSpeed(bool left,uint32_t speed) {
  switch(selection) {
    case 1: return left?(int32_t)speed:0;
    case 2: return left?-(int32_t)speed:0;
    case 3: return left?0:(int32_t)speed;
    case 4: return left?0:-(int32_t)speed;
    case 5: return (int32_t)speed;
    case 6: return -(int32_t)speed;
    case 7: return left ? (int32_t)speed : (int32_t)(speed/2);  // test independent LEDC frequencies
    default:return 0;
  }
}
static bool applySpeed(uint32_t speed,uint32_t now) {
  return motor.command(signedSpeed(true,speed), signedSpeed(false,speed),now);
}
static void stopTest(const __FlashStringHelper *message) {
  motor.disable();active=false;currentSps=0;
  Serial.println(message);
}
static void beginTest() {
  if(active || !motor.ready()) return;
  startMs=millis();lastUpdateMs=startMs;
  // Start slow and accelerate (20000 STEP/s^2): a stepper cannot follow
  // large instant frequency jumps and will stall (buzz without rotating).
  holding=false;
  currentSps=RATES[rateIndex]<START_SPS?RATES[rateIndex]:START_SPS;
  if(!applySpeed(currentSps,startMs)) {
    stopTest(F("FAULT: LEDC start failed"));return;
  }
  active=true;
  Serial.print(F("TEST START target STEP/s="));Serial.println(RATES[rateIndex]);
  Serial.println(F("LEDC hardware STEP active; ramp then 2s hold; WHEELS OFF GROUND"));
}
static void help() {
  Serial.println(F("=== E.D.A dengebot v1.7.6 STEP/DIR FIX3 ==="));
  Serial.println(F("ESP32-WROOM, LEDC HW pulse output. No PID, no MPU."));
  Serial.println(F("1/2 left +/- ; 3/4 right +/- ; 5/6 both +/- ; 7=both, different speeds"));
  Serial.println(F("+/- rate; p=test 2s; s=STOP; ?=help"));
  Serial.println(F("STEP/s: 200,500,1000,2000,5000,10000,20000,40000"));
  Serial.println(F("Pins: left STEP18 DIR19, right STEP23 DIR5, ENABLE33 active LOW"));
  Serial.println(F("10k pull-up EN to 3.3V required; driver GND common"));
  Serial.println(F("Motor physical motion NOT inferred from software messages"));
}
void setup() {
  Serial.begin(115200);
  if(!motor.begin()) { Serial.println(F("FAULT: LEDC hardware init failed"));return; }
  help();
  Serial.println(F("READY, motors disabled. Wheels OFF ground. Send p."));
}
void loop() {
  while(Serial.available()) {
    char c=(char)Serial.read();
    if(c=='s'||c=='S') {stopTest(F("STOP; ENABLE HIGH"));}
    else if(c=='?')help();
    else if(!active && c>='1' && c<='7') {
      selection=(uint8_t)(c-'0');
      Serial.print(F("Motor selection="));Serial.println(selection);
    } else if(!active && c=='+' && rateIndex<RATE_COUNT-1) {
      ++rateIndex;Serial.print(F("Target STEP/s="));Serial.println(RATES[rateIndex]);
    } else if(!active && c=='-' && rateIndex>0) {
      --rateIndex;Serial.print(F("Target STEP/s="));Serial.println(RATES[rateIndex]);
    } else if(!active && (c=='p'||c=='P'))beginTest();
  }
  if(!active)return;
  const uint32_t now=millis();
  if(holding?(uint32_t)(now-holdStartMs)>=TEST_MS:(uint32_t)(now-startMs)>=MAX_TEST_MS) {
    stopTest(F("TEST END; pulses stopped; ENABLE HIGH"));return;
  }
  if(!motor.watchdog(now,150)) {
    stopTest(F("FAULT: command refresh timeout"));return;
  }
  if((uint32_t)(now-lastUpdateMs)>=RAMP_INTERVAL_MS) {
    lastUpdateMs=now;
    const uint32_t goal=RATES[rateIndex];
    if(currentSps<goal) {
      const uint32_t remaining=goal-currentSps;
      currentSps+=remaining<RAMP_INCREMENT_SPS?remaining:RAMP_INCREMENT_SPS;
    }
    if(!holding && currentSps>=goal) {holding=true;holdStartMs=now;}
    if(!applySpeed(currentSps,now)) {
      stopTest(F("FAULT: LEDC frequency rejected"));return;
    }
  }
}
#else
// Safe inert compile on non-classic ESP32 targets.
void setup() {}
void loop() {}
#endif
